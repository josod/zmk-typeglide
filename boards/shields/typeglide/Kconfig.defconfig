## boards/shields/typeglide/Kconfig.defconfig
```kconfig
if SHIELD_TYPEGLIDE_LEFT || SHIELD_TYPEGLIDE_RIGHT

config ZMK_KEYBOARD_NAME
    default "TypeGlide"

config ZMK_SPLIT
    default y

if SHIELD_TYPEGLIDE_LEFT
config ZMK_SPLIT_ROLE_CENTRAL
    default y
endif # SHIELD_TYPEGLIDE_LEFT

endif # SHIELD_TYPEGLIDE_LEFT || SHIELD_TYPEGLIDE_RIGHT
```

## boards/shields/typeglide/Kconfig.shield
```kconfig
config SHIELD_TYPEGLIDE_LEFT
    def_bool $(shields_list_contains,typeglide_left)

config SHIELD_TYPEGLIDE_RIGHT
    def_bool $(shields_list_contains,typeglide_right)
```

## dts/bindings/typeglide,caps-word-or-scroll.yaml
```yaml
description: Caps Word or scroll behavior with delayed modifier decision
compatible: "typeglide,caps-word-or-scroll"

include: zero_param.yaml

properties:
  bindings:
    type: phandle-array
    required: true

  mods:
    type: int
    required: true

  timeout-ms:
    type: int
    required: false
    default: 300
```

## dts/bindings/typeglide,input-processor-stop.yaml
```yaml
description: Input processor that stops input events

compatible: "typeglide,input-processor-stop"

include: ip_zero_param.yaml
```

## dts/bindings/typeglide,joystick-4way.yaml
```yaml
description: Typeglide 4-way joystick input processor

compatible: "typeglide,joystick-4way"

include: ip_zero_param.yaml

properties:
  threshold:
    type: int
    required: false
    default: 10
    description: >
      Minimum joystick magnitude required to leave the center deadzone.

  rotation-deg:
    type: int
    required: false
    default: 0
    description: >
      Global joystick rotation correction in degrees.

  hysteresis-deg:
    type: int
    required: false
    default: 10
    description: >
      Angular hysteresis around the four sector boundaries.

  bindings:
    type: phandle-array
    required: true
    description: >
      Four ZMK behavior bindings in RIGHT, LEFT, DOWN, UP order.

  layer-count:
    type: int
    required: true
```

## dts/bindings/typeglide,mouse-layer-gate.yaml
```yaml
description: Gate input events to a specific ZMK keymap layer

compatible: "typeglide,mouse-layer-gate"

include: ip_zero_param.yaml

properties:
  layer:
    type: int
    required: true
```
